// Copyright (C) 2023-2026 Ola Gatner
// SPDX-License-Identifier: AGPL-3.0-only OR LicenseRef-AmyCore-Commercial
// AMY enable board (LOLIN S2 Mini, ESP32-S2)
//
// - SIG_FREQ_HZ square wave on PIN_ENABLE_SIG, generated by the LEDC peripheral
// - relay for robot 24V DC, relay AUX
// - onboard LED: on for LED_BOOT_MS after boot, then on while the enable wave is running
// - read-back: PCNT counts rising edges on PIN_ENABLE_SIG itself, reported as hz= in the status line,
//   so the PC can check that the wave really toggles (and really stops)
// - the square wave runs ONLY while the PC keeps talking: no valid command for
//   KEEPALIVE_TIMEOUT_MS -> wave stops (pin held at SIG_IDLE_LEVEL) and the enable
//   request is dropped. PC must send E1 again to restart (trip is latched).
//
// Serial protocol (USB CDC, lines ending with \r or \n, any valid line = keepalive):
//   K        keepalive, no reply
//   E1 / E0  request enable signal on / off (E1 needs 24V relay on)
//   P1 / P0  24V relay on / off (P0 also drops the enable request)
//   A1 / A0  AUX relay on / off
//   T1 / T0  bench test: run the wave WITHOUT the 24V relay (for the scope), keepalive still required.
//            T1 also requests enable; T0 and P0 end the test.
//   S        status -> "ST en=<req> sig=<running> p24=<0|1> aux=<0|1> test=<0|1> ka=<ms since last cmd> trips=<n> hz=<measured>"
//   XY       legacy from AmyCore setRelays(relHB, rel24V): X = AUX relay (IO12), Y = 24V relay (IO11), X,Y are '0'/'1'
// Replies: "OK <cmd>", "ERR <reason>", async "EV TRIP" when the keepalive watchdog stops the signal.

#include <Arduino.h>
#include <driver/ledc.h>
#include <driver/pcnt.h>
#include <driver/gpio.h>
#include <soc/io_mux_reg.h>
#include <esp_timer.h>
#include <esp_task_wdt.h>

// ---- hardware config ----
#define PIN_ENABLE_SIG        7
#define PIN_RELAY_24V         11
#define PIN_RELAY_AUX         12     // "Enable HB" checkbox in AmyCore
#define PIN_LED               LED_BUILTIN // GPIO15 on the S2 Mini, active high
#define RELAY_ON_LEVEL        HIGH   // set LOW for active-low relay modules
#define SIG_IDLE_LEVEL        0      // level held on PIN_ENABLE_SIG while the wave is stopped

// ---- timing config ----
#define SIG_FREQ_HZ           550
#define KEEPALIVE_TIMEOUT_MS  50     // PC should send K every ~10 ms
#define SUPERVISOR_PERIOD_US  1000
#define LED_BOOT_MS           1000
#define TASK_WDT_TIMEOUT_S    1      // hung firmware -> panic reset -> pins released

#define LEDC_MODE     LEDC_LOW_SPEED_MODE
#define LEDC_CH       LEDC_CHANNEL_0
#define LEDC_TMR      LEDC_TIMER_0
#define LEDC_RES      LEDC_TIMER_10_BIT
#define LEDC_HALF     512            // 50% duty at 10 bit

#define PCNT_UNIT     PCNT_UNIT_0
#define MEAS_PERIOD_MS 100           // read-back window, hz = edges * 1000 / MEAS_PERIOD_MS

static volatile bool     enableRequested = false;
static volatile bool     sigRunning      = false;
static volatile bool     relay24vOn      = false;
static volatile bool     relayAuxOn      = false;
static volatile bool     testMode        = false;
static volatile uint32_t lastKeepaliveMs = 0;
static volatile uint32_t tripCount       = 0;
static volatile bool     tripPending     = false;
static volatile uint32_t measuredHz      = 0;

static char   lineBuf[16];
static size_t lineLen = 0;

static void sigStart()
{
    ledc_set_duty(LEDC_MODE, LEDC_CH, LEDC_HALF);
    ledc_update_duty(LEDC_MODE, LEDC_CH);
}

static void sigStop()
{
    ledc_stop(LEDC_MODE, LEDC_CH, SIG_IDLE_LEVEL);
}

static void setRelay24v(bool on)
{
    if (!on)
    {
        enableRequested = false;
        testMode        = false;
        delay(2 * SUPERVISOR_PERIOD_US / 1000 + 1); // let the supervisor stop the wave first
    }
    relay24vOn = on;
    digitalWrite(PIN_RELAY_24V, on ? RELAY_ON_LEVEL : !RELAY_ON_LEVEL);
}

static void setRelayAux(bool on)
{
    relayAuxOn = on;
    digitalWrite(PIN_RELAY_AUX, on ? RELAY_ON_LEVEL : !RELAY_ON_LEVEL);
}

// Runs every SUPERVISOR_PERIOD_US in the esp_timer task, independent of loop().
// It is the only place that starts/stops the wave, so a stuck loop() also stops it.
static void supervisorTick(void*)
{
    uint32_t last = lastKeepaliveMs; // read before millis() so now >= last
    uint32_t now  = millis();

    static uint32_t measTicks = 0;
    if (++measTicks >= MEAS_PERIOD_MS * 1000 / SUPERVISOR_PERIOD_US)
    {
        int16_t cnt = 0;
        pcnt_get_counter_value(PCNT_UNIT, &cnt);
        pcnt_counter_clear(PCNT_UNIT);
        measuredHz = (uint32_t)cnt * 1000 / MEAS_PERIOD_MS;
        measTicks  = 0;
    }

    if (enableRequested && (now - last) >= KEEPALIVE_TIMEOUT_MS)
    {
        enableRequested = false;
        testMode        = false;
        tripCount++;
        tripPending = true;
    }

    bool want = enableRequested && (relay24vOn || testMode);
    if (want != sigRunning)
    {
        if (want) sigStart();
        else      sigStop();
        sigRunning = want;
    }
}

// PCNT reads the pin back through the GPIO matrix. It must be configured before LEDC:
// pcnt_unit_config() makes the pin an input, ledc_channel_config() then makes it an output
// (and turns the input buffer off), so the input buffer is switched back on at the end.
static void setupReadback()
{
    pcnt_config_t cfg = {};
    cfg.pulse_gpio_num = PIN_ENABLE_SIG;
    cfg.ctrl_gpio_num  = PCNT_PIN_NOT_USED;
    cfg.channel        = PCNT_CHANNEL_0;
    cfg.unit           = PCNT_UNIT;
    cfg.pos_mode       = PCNT_COUNT_INC;   // rising edges
    cfg.neg_mode       = PCNT_COUNT_DIS;
    cfg.lctrl_mode     = PCNT_MODE_KEEP;
    cfg.hctrl_mode     = PCNT_MODE_KEEP;
    cfg.counter_h_lim  = 32767;
    cfg.counter_l_lim  = -1;
    ESP_ERROR_CHECK(pcnt_unit_config(&cfg));
    pcnt_set_filter_value(PCNT_UNIT, 100);   // ignore glitches < 1.25 us
    pcnt_filter_enable(PCNT_UNIT);
    pcnt_counter_clear(PCNT_UNIT);
    pcnt_counter_resume(PCNT_UNIT);
}

static void setupSignal()
{
    ledc_timer_config_t tcfg = {};
    tcfg.speed_mode      = LEDC_MODE;
    tcfg.duty_resolution = LEDC_RES;
    tcfg.timer_num       = LEDC_TMR;
    tcfg.freq_hz         = SIG_FREQ_HZ;
    tcfg.clk_cfg         = LEDC_AUTO_CLK;
    ESP_ERROR_CHECK(ledc_timer_config(&tcfg));

    ledc_channel_config_t ccfg = {};
    ccfg.gpio_num   = PIN_ENABLE_SIG;
    ccfg.speed_mode = LEDC_MODE;
    ccfg.channel    = LEDC_CH;
    ccfg.timer_sel  = LEDC_TMR;
    ccfg.duty       = 0;
    ccfg.hpoint     = 0;
    ESP_ERROR_CHECK(ledc_channel_config(&ccfg));
    sigStop();

    PIN_INPUT_ENABLE(GPIO_PIN_MUX_REG[PIN_ENABLE_SIG]);  // read-back: input buffer on, output stays on LEDC
    gpio_set_pull_mode((gpio_num_t)PIN_ENABLE_SIG, GPIO_FLOATING); // pcnt_unit_config() turned a pull-up on
}

static void handleLine(const char* cmd)
{
    uint32_t kaAge  = millis() - lastKeepaliveMs;
    lastKeepaliveMs = millis();

    if (strcmp(cmd, "K") == 0) return;

    if (strcmp(cmd, "S") == 0)
    {
        Serial.printf("ST en=%d sig=%d p24=%d aux=%d test=%d ka=%lu trips=%lu hz=%lu\n",
                      enableRequested, sigRunning, relay24vOn, relayAuxOn, testMode,
                      (unsigned long)kaAge, (unsigned long)tripCount, (unsigned long)measuredHz);
        return;
    }

    if (strlen(cmd) == 2 && (cmd[1] == '0' || cmd[1] == '1'))
    {
        bool on = cmd[1] == '1';
        switch (cmd[0])
        {
        case 'E':
            if (on && !relay24vOn && !testMode) { Serial.println("ERR 24V_OFF"); return; }
            enableRequested = on;
            break;
        case 'T':
            if (on) { testMode = true; enableRequested = true; }
            else    { enableRequested = false; testMode = false; }
            break;
        case 'P': setRelay24v(on); break;
        case 'A': setRelayAux(on); break;
        case '0':
        case '1': // legacy setRelays(r1, r2): r1 = AUX, r2 = 24V
            setRelayAux(cmd[0] == '1');
            setRelay24v(on);
            break;
        default:
            Serial.printf("ERR UNKNOWN %s\n", cmd);
            return;
        }
        Serial.printf("OK %s\n", cmd);
        return;
    }

    Serial.printf("ERR UNKNOWN %s\n", cmd);
}

void setup()
{
    // outputs to a safe state before anything else
    digitalWrite(PIN_RELAY_24V, !RELAY_ON_LEVEL);
    digitalWrite(PIN_RELAY_AUX, !RELAY_ON_LEVEL);
    pinMode(PIN_RELAY_24V, OUTPUT);
    pinMode(PIN_RELAY_AUX, OUTPUT);
    pinMode(PIN_LED, OUTPUT);
    digitalWrite(PIN_LED, HIGH);
    setupReadback();
    setupSignal();

    // larger USB CDC receive buffer (default 256 bytes): the S2's USB serial has stalled several times
    // while the robot's motors were active; a full RX queue is one suspected cause (ground-loop noise the other)
    Serial.setRxBufferSize(1024);
    Serial.begin(115200);
    Serial.setTxTimeoutMs(0); // never block loop() when no host is reading

    esp_task_wdt_init(TASK_WDT_TIMEOUT_S, true);
    esp_task_wdt_add(NULL);

    const esp_timer_create_args_t targs = {
        .callback        = supervisorTick,
        .arg             = nullptr,
        .dispatch_method = ESP_TIMER_TASK,
        .name            = "sig_supervisor",
        .skip_unhandled_events = true,
    };
    esp_timer_handle_t timer;
    ESP_ERROR_CHECK(esp_timer_create(&targs, &timer));
    ESP_ERROR_CHECK(esp_timer_start_periodic(timer, SUPERVISOR_PERIOD_US));

    Serial.println("READY amy-enable");
}

void loop()
{
    esp_task_wdt_reset();

    while (Serial.available())
    {
        char c = toupper(Serial.read());
        if (c == '\r' || c == '\n')
        {
            if (lineLen)
            {
                lineBuf[lineLen] = 0;
                handleLine(lineBuf);
                lineLen = 0;
            }
        }
        else if (lineLen < sizeof(lineBuf) - 1)
        {
            lineBuf[lineLen++] = c;
        }
        else
        {
            lineLen = 0; // overlong garbage, drop it
        }
    }

    digitalWrite(PIN_LED, sigRunning || millis() < LED_BOOT_MS);

    if (tripPending)
    {
        tripPending = false;
        Serial.println("EV TRIP");
    }
}
